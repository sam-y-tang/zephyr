## boards/xtensa/heltec_wifi32_v3/Kconfig.defconfig
```kconfig
# ESP32S3 heltec wifi32 v3 board configuration

# Copyright (c) 2022 Espressif Systems (Shanghai) Co., Ltd.
# SPDX-License-Identifier: Apache-2.0

config BOARD
	default "heltec_wifi32_v3"
	depends on BOARD_HELTEC_WIFI32_V3

config ENTROPY_GENERATOR
	default y
```

## boards/xtensa/heltec_wifi_lora32_v3/Kconfig.board
```kconfig
# ESP32S3 DevKitM board configuration

# Copyright (c) 2022 Espressif Systems (Shanghai) Co., Ltd.
# SPDX-License-Identifier: Apache-2.0

config BOARD_HELTEC_WIFI_LORA32_V3
	bool "HELTEC WiFi LoRa 32 (V3) Board"
	depends on SOC_ESP32S3
```

## boards/xtensa/heltec_wifi_lora32_v3/Kconfig.defconfig
```kconfig
# ESP32S3 DevKitM board configuration

# Copyright (c) 2022 Espressif Systems (Shanghai) Co., Ltd.
# SPDX-License-Identifier: Apache-2.0

config BOARD
	default "heltec_wifi_lora_v3"
	depends on BOARD_HELTEC_WIFI_LORA32_V3

config ENTROPY_GENERATOR
	default y
```
